## build/Kconfig/arch/Kconfig
```kconfig
# Load arch Kconfig descriptions.
osource "/Users/jamespentz/code/zephyr/nucleo_sdmmc/zephyr/arch/x86/Kconfig"
osource "/Users/jamespentz/code/zephyr/nucleo_sdmmc/zephyr/arch/xtensa/Kconfig"
osource "/Users/jamespentz/code/zephyr/nucleo_sdmmc/zephyr/arch/sparc/Kconfig"
osource "/Users/jamespentz/code/zephyr/nucleo_sdmmc/zephyr/arch/riscv/Kconfig"
osource "/Users/jamespentz/code/zephyr/nucleo_sdmmc/zephyr/arch/posix/Kconfig"
osource "/Users/jamespentz/code/zephyr/nucleo_sdmmc/zephyr/arch/nios2/Kconfig"
osource "/Users/jamespentz/code/zephyr/nucleo_sdmmc/zephyr/arch/mips/Kconfig"
osource "/Users/jamespentz/code/zephyr/nucleo_sdmmc/zephyr/arch/arm64/Kconfig"
osource "/Users/jamespentz/code/zephyr/nucleo_sdmmc/zephyr/arch/arm/Kconfig"
osource "/Users/jamespentz/code/zephyr/nucleo_sdmmc/zephyr/arch/arc/Kconfig"
```

## build/Kconfig/soc/Kconfig
```kconfig
# Load Zephyr SoC Kconfig descriptions.
osource "/Users/jamespentz/code/zephyr/nucleo_sdmmc/zephyr/soc/xlnx/zynqmp/Kconfig"
osource "/Users/jamespentz/code/zephyr/nucleo_sdmmc/zephyr/soc/xlnx/zynq7000/Kconfig"
osource "/Users/jamespentz/code/zephyr/nucleo_sdmmc/zephyr/soc/xen/Kconfig"
osource "/Users/jamespentz/code/zephyr/nucleo_sdmmc/zephyr/soc/ti/simplelink/Kconfig"
osource "/Users/jamespentz/code/zephyr/nucleo_sdmmc/zephyr/soc/ti/lm3s6965/Kconfig"
osource "/Users/jamespentz/code/zephyr/nucleo_sdmmc/zephyr/soc/ti/k3/Kconfig"
osource "/Users/jamespentz/code/zephyr/nucleo_sdmmc/zephyr/soc/telink/tlsr/Kconfig"
osource "/Users/jamespentz/code/zephyr/nucleo_sdmmc/zephyr/soc/starfive/jh71xx/Kconfig"
osource "/Users/jamespentz/code/zephyr/nucleo_sdmmc/zephyr/soc/st/stm32/Kconfig"
osource "/Users/jamespentz/code/zephyr/nucleo_sdmmc/zephyr/soc/snps/qemu_arc/Kconfig"
osource "/Users/jamespentz/code/zephyr/nucleo_sdmmc/zephyr/soc/snps/nsim/arc_v/Kconfig"
osource "/Users/jamespentz/code/zephyr/nucleo_sdmmc/zephyr/soc/snps/nsim/arc_classic/Kconfig"
osource "/Users/jamespentz/code/zephyr/nucleo_sdmmc/zephyr/soc/snps/hsdk4xd/Kconfig"
osource "/Users/jamespentz/code/zephyr/nucleo_sdmmc/zephyr/soc/snps/hsdk/Kconfig"
osource "/Users/jamespentz/code/zephyr/nucleo_sdmmc/zephyr/soc/snps/emsk/Kconfig"
osource "/Users/jamespentz/code/zephyr/nucleo_sdmmc/zephyr/soc/snps/emsdp/Kconfig"
osource "/Users/jamespentz/code/zephyr/nucleo_sdmmc/zephyr/soc/snps/arc_iot/Kconfig"
osource "/Users/jamespentz/code/zephyr/nucleo_sdmmc/zephyr/soc/silabs/Kconfig"
osource "/Users/jamespentz/code/zephyr/nucleo_sdmmc/zephyr/soc/sifive/sifive_freedom/Kconfig"
osource "/Users/jamespentz/code/zephyr/nucleo_sdmmc/zephyr/soc/sensry/Kconfig"
osource "/Users/jamespentz/code/zephyr/nucleo_sdmmc/zephyr/soc/rockchip/Kconfig"
osource "/Users/jamespentz/code/zephyr/nucleo_sdmmc/zephyr/soc/renode/riscv_virtual/Kconfig"
osource "/Users/jamespentz/code/zephyr/nucleo_sdmmc/zephyr/soc/renode/cortex_r8_virtual/Kconfig"
osource "/Users/jamespentz/code/zephyr/nucleo_sdmmc/zephyr/soc/renesas/smartbond/Kconfig"
osource "/Users/jamespentz/code/zephyr/nucleo_sdmmc/zephyr/soc/renesas/rzt2m/Kconfig"
osource "/Users/jamespentz/code/zephyr/nucleo_sdmmc/zephyr/soc/renesas/rcar/Kconfig"
osource "/Users/jamespentz/code/zephyr/nucleo_sdmmc/zephyr/soc/renesas/ra/Kconfig"
osource "/Users/jamespentz/code/zephyr/nucleo_sdmmc/zephyr/soc/raspberrypi/Kconfig"
osource "/Users/jamespentz/code/zephyr/nucleo_sdmmc/zephyr/soc/quicklogic/eos_s3/Kconfig"
osource "/Users/jamespentz/code/zephyr/nucleo_sdmmc/zephyr/soc/qemu/virt_riscv/Kconfig"
osource "/Users/jamespentz/code/zephyr/nucleo_sdmmc/zephyr/soc/qemu/malta/Kconfig"
osource "/Users/jamespentz/code/zephyr/nucleo_sdmmc/zephyr/soc/openisa/rv32m1/Kconfig"
osource "/Users/jamespentz/code/zephyr/nucleo_sdmmc/zephyr/soc/nxp/s32/Kconfig"
osource "/Users/jamespentz/code/zephyr/nucleo_sdmmc/zephyr/soc/nxp/rw/Kconfig"
osource "/Users/jamespentz/code/zephyr/nucleo_sdmmc/zephyr/soc/nxp/mcx/Kconfig"
osource "/Users/jamespentz/code/zephyr/nucleo_sdmmc/zephyr/soc/nxp/lpc/Kconfig"
osource "/Users/jamespentz/code/zephyr/nucleo_sdmmc/zephyr/soc/nxp/layerscape/Kconfig"
osource "/Users/jamespentz/code/zephyr/nucleo_sdmmc/zephyr/soc/nxp/kinetis/Kconfig"
osource "/Users/jamespentz/code/zephyr/nucleo_sdmmc/zephyr/soc/nxp/imxrt/Kconfig"
osource "/Users/jamespentz/code/zephyr/nucleo_sdmmc/zephyr/soc/nxp/imx/Kconfig"
osource "/Users/jamespentz/code/zephyr/nucleo_sdmmc/zephyr/soc/nuvoton/numicro/Kconfig"
osource "/Users/jamespentz/code/zephyr/nucleo_sdmmc/zephyr/soc/nuvoton/numaker/Kconfig"
osource "/Users/jamespentz/code/zephyr/nucleo_sdmmc/zephyr/soc/nuvoton/npcx/Kconfig"
osource "/Users/jamespentz/code/zephyr/nucleo_sdmmc/zephyr/soc/nuvoton/npcm/Kconfig"
osource "/Users/jamespentz/code/zephyr/nucleo_sdmmc/zephyr/soc/nordic/Kconfig"
osource "/Users/jamespentz/code/zephyr/nucleo_sdmmc/zephyr/soc/neorv32/Kconfig"
osource "/Users/jamespentz/code/zephyr/nucleo_sdmmc/zephyr/soc/native/inf_clock/Kconfig"
osource "/Users/jamespentz/code/zephyr/nucleo_sdmmc/zephyr/soc/microchip/miv/Kconfig"
osource "/Users/jamespentz/code/zephyr/nucleo_sdmmc/zephyr/soc/microchip/mec/Kconfig"
osource "/Users/jamespentz/code/zephyr/nucleo_sdmmc/zephyr/soc/mediatek/mtk_adsp/Kconfig"
osource "/Users/jamespentz/code/zephyr/nucleo_sdmmc/zephyr/soc/lowrisc/opentitan/Kconfig"
osource "/Users/jamespentz/code/zephyr/nucleo_sdmmc/zephyr/soc/litex/litex_vexriscv/Kconfig"
osource "/Users/jamespentz/code/zephyr/nucleo_sdmmc/zephyr/soc/ite/ec/Kconfig"
osource "/Users/jamespentz/code/zephyr/nucleo_sdmmc/zephyr/soc/intel/raptor_lake/Kconfig"
osource "/Users/jamespentz/code/zephyr/nucleo_sdmmc/zephyr/soc/intel/lakemont/Kconfig"
osource "/Users/jamespentz/code/zephyr/nucleo_sdmmc/zephyr/soc/intel/intel_socfpga_std/Kconfig"
osource "/Users/jamespentz/code/zephyr/nucleo_sdmmc/zephyr/soc/intel/intel_socfpga/Kconfig"
osource "/Users/jamespentz/code/zephyr/nucleo_sdmmc/zephyr/soc/intel/intel_niosv/Kconfig"
osource "/Users/jamespentz/code/zephyr/nucleo_sdmmc/zephyr/soc/intel/intel_ish/Kconfig"
osource "/Users/jamespentz/code/zephyr/nucleo_sdmmc/zephyr/soc/intel/intel_adsp/Kconfig"
osource "/Users/jamespentz/code/zephyr/nucleo_sdmmc/zephyr/soc/intel/elkhart_lake/Kconfig"
osource "/Users/jamespentz/code/zephyr/nucleo_sdmmc/zephyr/soc/intel/atom/Kconfig"
osource "/Users/jamespentz/code/zephyr/nucleo_sdmmc/zephyr/soc/intel/apollo_lake/Kconfig"
osource "/Users/jamespentz/code/zephyr/nucleo_sdmmc/zephyr/soc/intel/alder_lake/Kconfig"
osource "/Users/jamespentz/code/zephyr/nucleo_sdmmc/zephyr/soc/infineon/cat3/Kconfig"
osource "/Users/jamespentz/code/zephyr/nucleo_sdmmc/zephyr/soc/infineon/cat1b/Kconfig"
osource "/Users/jamespentz/code/zephyr/nucleo_sdmmc/zephyr/soc/infineon/cat1a/Kconfig"
osource "/Users/jamespentz/code/zephyr/nucleo_sdmmc/zephyr/soc/gd/gd32/Kconfig"
osource "/Users/jamespentz/code/zephyr/nucleo_sdmmc/zephyr/soc/gaisler/leon3/Kconfig"
osource "/Users/jamespentz/code/zephyr/nucleo_sdmmc/zephyr/soc/gaisler/gr716a/Kconfig"
osource "/Users/jamespentz/code/zephyr/nucleo_sdmmc/zephyr/soc/espressif/Kconfig"
osource "/Users/jamespentz/code/zephyr/nucleo_sdmmc/zephyr/soc/ene/kb1200/Kconfig"
osource "/Users/jamespentz/code/zephyr/nucleo_sdmmc/zephyr/soc/efinix/sapphire/Kconfig"
osource "/Users/jamespentz/code/zephyr/nucleo_sdmmc/zephyr/soc/cdns/xtensa_sample_controller/Kconfig"
osource "/Users/jamespentz/code/zephyr/nucleo_sdmmc/zephyr/soc/cdns/sample_controller32/Kconfig"
osource "/Users/jamespentz/code/zephyr/nucleo_sdmmc/zephyr/soc/cdns/dc233c/Kconfig"
osource "/Users/jamespentz/code/zephyr/nucleo_sdmmc/zephyr/soc/brcm/bcmvk/Kconfig"
osource "/Users/jamespentz/code/zephyr/nucleo_sdmmc/zephyr/soc/brcm/bcm2712/Kconfig"
osource "/Users/jamespentz/code/zephyr/nucleo_sdmmc/zephyr/soc/brcm/bcm2711/Kconfig"
osource "/Users/jamespentz/code/zephyr/nucleo_sdmmc/zephyr/soc/atmel/sam0/Kconfig"
osource "/Users/jamespentz/code/zephyr/nucleo_sdmmc/zephyr/soc/atmel/sam/Kconfig"
osource "/Users/jamespentz/code/zephyr/nucleo_sdmmc/zephyr/soc/aspeed/Kconfig"
osource "/Users/jamespentz/code/zephyr/nucleo_sdmmc/zephyr/soc/arm/Kconfig"
osource "/Users/jamespentz/code/zephyr/nucleo_sdmmc/zephyr/soc/arm/beetle/Kconfig"
osource "/Users/jamespentz/code/zephyr/nucleo_sdmmc/zephyr/soc/andestech/Kconfig"
osource "/Users/jamespentz/code/zephyr/nucleo_sdmmc/zephyr/soc/ambiq/Kconfig"
osource "/Users/jamespentz/code/zephyr/nucleo_sdmmc/zephyr/soc/altr/zephyr_nios2f/Kconfig"
osource "/Users/jamespentz/code/zephyr/nucleo_sdmmc/zephyr/soc/altr/qemu_nios2/Kconfig"
osource "/Users/jamespentz/code/zephyr/nucleo_sdmmc/zephyr/soc/adi/max32/Kconfig"
```
